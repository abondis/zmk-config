/*
 * Copyright (c) 2020 The ZMK Contributors
 *
 * SPDX-License-Identifier: MIT
 */

#include "microdox_mod.dtsi"

&kscan0 {
	col-gpios
		= <&pro_micro  3 GPIO_ACTIVE_HIGH>
		, <&pro_micro  2 GPIO_ACTIVE_HIGH>
		, <&pro_micro  1 GPIO_ACTIVE_HIGH>
		, <&pro_micro  0 GPIO_ACTIVE_HIGH>
		, <&pro_micro 15 GPIO_ACTIVE_HIGH>
		;
	debounce-period = <20>;
};

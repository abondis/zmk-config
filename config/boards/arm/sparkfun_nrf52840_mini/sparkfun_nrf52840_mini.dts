/*
 * Copyright (c) 2021 The ZMK Contributors
 *
 * SPDX-License-Identifier: MIT
 */

/dts-v1/;
#include "sparkfun_nrf52840_mini.dtsi"

// / {
//     chosen {
//         zmk,battery = &vbatt;
//     };
// 
//     // Node name must match original "EXT_POWER" label to preserve user settings.
//     EXT_POWER {
//         compatible = "zmk,ext-power-generic";
//         control-gpios = <&gpio0 13 GPIO_ACTIVE_HIGH>;
//         init-delay-ms = <50>;
//     };
// 
//     vbatt: vbatt {
//         compatible = "zmk,battery-nrf-vddh";
//     };

/ {
//	ext-power {
//		compatible = "zmk,ext-power-generic";
//		label = "EXT_POWER";
//		control-gpios = <&gpio0 13 GPIO_ACTIVE_LOW>;
//	};
//
//	vbatt {
//		compatible = "zmk,battery-voltage-divider";
//		label = "BATTERY";
//		io-channels = <&adc 2>;
//		output-ohms = <2000000>;
//		full-ohms = <(2000000 + 806000)>;
//	};
};


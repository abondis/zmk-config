## config/boards/arm/sparkfun_nrf52840_mini/Kconfig.board
```kconfig
# SF 52840 mini board configuration

# Copyright (c) 2020 Pete Johanson
# SPDX-License-Identifier: MIT

config BOARD_SF_52840
	bool "sparkfun_nrf52840_mini"
	depends on SOC_NRF52840_QIAA
```

## config/boards/arm/sparkfun_nrf52840_mini/Kconfig.defconfig
```kconfig
# Copyright (c) 2021 The ZMK Contributors
# SPDX-License-Identifier: MIT

if BOARD_SF_52840

config BOARD
	default "sparkfun_nrf52840_mini"



config NFCT_PINS_AS_GPIOS
    bool "NFCT pins as GPIOs"
    default n
    depends on HAS_HW_NRF_NFCT && SOC_FAMILY_NRF
    help
      P0.9 and P0.10 are usually reserved for NFC. This option switch
      them to normal GPIO mode. HW enabling happens once in the device
      lifetime, during the first system startup. Disabling this option will
      not switch back these pins to NFCT mode. Doing this requires UICR
      erase prior to flashing device using the image which has
      this option disabled.

if USB_DEVICE_STACK
config USB_NRFX
	default y

endif # USB_DEVICE_STACK

config BT_CTLR
	default BT


config ZMK_BATTERY_VOLTAGE_DIVIDER
#  default y
 	default n

endif # BOARD_SF_52840


# config ZMK_BATTERY_NRF_VDDH
# # default y
#  	default n
```

## config/boards/arm/sparkfun_nrf52840_mini/sparkfun_nrf52840_mini_defconfig
```kconfig
# SPDX-License-Identifier: MIT

CONFIG_SOC_SERIES_NRF52X=y
CONFIG_SOC_NRF52840_QIAA=y
CONFIG_BOARD_SF_52840=y

# Enable MPU
CONFIG_ARM_MPU=y

# Use pinctrl
CONFIG_PINCTRL=y

# enable GPIO
CONFIG_GPIO=y

CONFIG_USE_DT_CODE_PARTITION=y
CONFIG_BUILD_OUTPUT_UF2=y

CONFIG_MPU_ALLOW_FLASH_WRITE=y
CONFIG_NVS=y
CONFIG_SETTINGS_NVS=y
CONFIG_FLASH=y
CONFIG_FLASH_PAGE_LAYOUT=y
CONFIG_FLASH_MAP=y

CONFIG_ZMK_BLE=y
CONFIG_ZMK_USB=y
# change pins 9 and 10 to GPIOS instead of NFC
CONFIG_NFCT_PINS_AS_GPIOS=y
```

## config/boards/shields/microdox_mod/Kconfig.shield
```kconfig
# Copyright (c) 2020 The ZMK Contributors
# SPDX-License-Identifier: MIT

config SHIELD_MICRODOX_MOD_LEFT
    def_bool $(shields_list_contains,microdox_mod_left)

config SHIELD_MICRODOX_MOD_RIGHT
    def_bool $(shields_list_contains,microdox_mod_right)

config SHIELD_MICRODOX_MOD_V2_LEFT
    def_bool $(shields_list_contains,microdox_mod_v2_left)

config SHIELD_MICRODOX_MOD_V2_RIGHT
    def_bool $(shields_list_contains,microdox_mod_v2_right)
```
